#ifdef OPENLUX_LOG_LEVEL_MAIN
OPENLUX_MODULE_LOG_LEVEL(main, OPENLUX_LOG_LEVEL_MAIN)
#endif
#ifdef OPENLUX_LOG_LEVEL_RS485
OPENLUX_MODULE_LOG_LEVEL(rs485, OPENLUX_LOG_LEVEL_RS485)
#endif
#ifdef OPENLUX_LOG_LEVEL_PROTO
OPENLUX_MODULE_LOG_LEVEL(proto, OPENLUX_LOG_LEVEL_PROTO)
#endif
#ifdef OPENLUX_LOG_LEVEL_NETWORK
OPENLUX_MODULE_LOG_LEVEL(net, OPENLUX_LOG_LEVEL_NETWORK)
#endif
#ifdef OPENLUX_LOG_LEVEL_MQTT
OPENLUX_MODULE_LOG_LEVEL(mqtt, OPENLUX_LOG_LEVEL_MQTT)
#endif
#ifdef OPENLUX_LOG_LEVEL_BRIDGE
OPENLUX_MODULE_LOG_LEVEL(bridge, OPENLUX_LOG_LEVEL_BRIDGE)
#endif
#ifdef OPENLUX_LOG_LEVEL_TCP
OPENLUX_MODULE_LOG_LEVEL(tcp_proto, OPENLUX_LOG_LEVEL_TCP)
#endif
#ifdef OPENLUX_LOG_LEVEL_SYSTEM
OPENLUX_MODULE_LOG_LEVEL(sys, OPENLUX_LOG_LEVEL_SYSTEM)
#endif
#ifdef OPENLUX_LOG_LEVEL_COMMAND
OPENLUX_MODULE_LOG_LEVEL(cmd, OPENLUX_LOG_LEVEL_COMMAND)
#endif
#ifdef OPENLUX_LOG_LEVEL_NTP
OPENLUX_MODULE_LOG_LEVEL(ntp, OPENLUX_LOG_LEVEL_NTP)
#endif
#ifdef OPENLUX_LOG_LEVEL_WEB
OPENLUX_MODULE_LOG_LEVEL(web, OPENLUX_LOG_LEVEL_WEB)
#endif
#ifdef OPENLUX_LOG_LEVEL_GUARD
OPENLUX_MODULE_LOG_LEVEL(guard, OPENLUX_LOG_LEVEL_GUARD)
#endif
